## boards/shields/corne_trackpad/Kconfig.defconfig
```kconfig
# Copyright (c) 2020 The ZMK Contributors
# SPDX-License-Identifier: MIT

if SHIELD_CORNE_TP_LEFT

config ZMK_KEYBOARD_NAME
	default "Corne TP"

config ZMK_SPLIT_ROLE_CENTRAL
	default y

endif

if SHIELD_CORNE_TP_RIGHT

config ZMK_KEYBOARD_NAME
	default "Corne TP"

config ZMK_POINTING
	default y

config I2C
	default y

config INPUT
	default y

endif

if SHIELD_CORNE_TP_LEFT || SHIELD_CORNE_TP_RIGHT

config ZMK_SPLIT
	default y

endif
```
