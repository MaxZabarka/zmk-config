/*
 * Copyright (c) 2020 The ZMK Contributors
 *
 * SPDX-License-Identifier: MIT
 */

#include <shields/corne/corne_right.overlay>
#include "corne_trackpad.dtsi"

&pro_micro_i2c {
    status = "okay";
    
    glidepoint: glidepoint@2a {
        compatible = "cirque,pinnacle";
        reg = <0x2a>;
        status = "okay";
        sensitivity = "4x";
        sleep;
        no-taps;
    };
};

&glidepoint_split {
    device = <&glidepoint>;
};
